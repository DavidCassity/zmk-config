## config/boards/shields/zesty/Kconfig.defconfig
```kconfig
if SHIELD_ZESTY_LEFT

config ZMK_KEYBOARD_NAME
    default "Zesty"

config ZMK_SPLIT_ROLE_CENTRAL
    default y

endif

if SHIELD_ZESTY_LEFT || SHIELD_ZESTY_RIGHT

config ZMK_SPLIT
    default y

endif
```

## config/boards/shields/zesty/Kconfig.shield
```kconfig
config SHIELD_ZESTY_LEFT
    def_bool $(shields_list_contains,zesty_left)

config SHIELD_ZESTY_RIGHT
    def_bool $(shields_list_contains,zesty_right)
```
